## package/djmount/Config.in
```kconfig
config BR2_PACKAGE_DJMOUNT
        bool "djmount"
	select BR2_PACKAGE_LIBFUSE
        help
	  djmount is a UPnP AV client. It mounts as a Linux filesystem (using FUSE) the media content of compatible UPnP AV devices : the Audio and Video content on the network is automatically discovered, and can be browsed as a standard directory tree.

	  http://djmount.sourceforge.net
```

## package/pistream/Config.in
```kconfig
source "package/pistream/snapcast/Config.in"
source "package/pistream/librespot/Config.in"
```

## package/pistream/pistream-node/Config.in
```kconfig
config BR2_PACKAGE_PISTREAM_NODE
	bool "pistream-node"
	select BR2_PACKAGE_NODEJS
	help
	  Synchronous multi-room audio system
```

## package/pistream/snapcast/Config.in
```kconfig
config BR2_PACKAGE_SNAPCAST
	bool "snapcast"
	select BR2_PACKAGE_FLAC
	help
	  Synchronous multi-room audio player
```

## package/rx/Config.in
```kconfig
config BR2_PACKAGE_RX
	bool "rx"
	select BR2_PACKAGE_ALSA-LIB
	select BR2_PACKAGE_OPUS
	select BR2_PACKAGE_ORTP
	help
		Audio streaming program

		https://github.com/awesomes4everyone/rpi-buildroot
```

## package/volumio2/Config.in
```kconfig
config BR2_PACKAGE_VOLUMIO2
        bool "Volumio2"
        help

	Volumio 2 - Audiophile Music Player

	http://volumio.org
```
